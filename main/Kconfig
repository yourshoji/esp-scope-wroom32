## main/Kconfig
```kconfig
menu "espScope Configuration"
    config LED_BUILTIN
        int "LED IO Pin"
        default 2
        help
            LED IO pin

    config BSP_CONFIG_GPIO
        int "Factory Reset Pin (GPIO)"
        default 0
        help
            GPIO pin number to hold low on boot to erase NVS (Factory Reset).
            Default is 0 (BOOT button on ESP32-WROOM-32D).

    config BOARD_SPECIFIC_INIT
        string "Name of file containing any board specfic initialisation"
        help
            If your board requires some specific initialization C code, place it in
            a file called "./boards/<your board name>.h" and set this to "./boards/your board name.h"
            Default is don't include any board-specific initialization file.

endmenu
```
